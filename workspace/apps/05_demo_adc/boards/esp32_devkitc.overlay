/{
    aliases {
        my-adc = &adc1;
        my-adc-channel = &adc1_ch3;
    };
};

// ADC2 (adc1) channel 3 is connected to GPIO15
&adc1 {
    status = "okay";
    #address-cells = <1>;
    #size-cells = <0>;

    adc1_ch3: channel@3 {
        reg = <3>;
        zephyr,gain = "ADC_GAIN_1_4";
        zephyr,reference = "ADC_REF_INTERNAL";
        zephyr,vref-mv = <3894>;
        zephyr,acquisition-time = <ADC_ACQ_TIME_DEFAULT>;
        zephyr,resolution = <12>;
    };
};
