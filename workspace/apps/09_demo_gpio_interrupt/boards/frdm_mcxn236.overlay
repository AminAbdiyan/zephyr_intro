/ {
    aliases {
        my-button = &button_1;
    };

    buttons {
        compatible = "gpio-keys";

        button_1: d0_20 {
            gpios = <&gpio0 20 (GPIO_ACTIVE_LOW | GPIO_PULL_UP)>;
        };
    };
};
