/ {
    aliases {
        my-button = &button_1;
    };

    buttons {
        compatible = "gpio-keys";
        debounce-interval-ms = <50>;
        polling-mode;

        button_1: d0 {
            gpios = <&gpio0 0 (GPIO_ACTIVE_LOW | GPIO_PULL_UP)>;
        };
    };
};